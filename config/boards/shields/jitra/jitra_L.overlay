#include "jitra.dtsi"

/{
    kscan0: kscan {
        compatible = "zmk,kscan-gpio-matrix";
        label = "KSCAN";
        diode-direction = "col2row";

        row-gpios
            = <&xiao_d 1 (GPIO_ACTIVE_HIGH | GPIO_PULL_DOWN)>  /* Row0 = P0.03 (D1) */
            , <&xiao_d 2 (GPIO_ACTIVE_HIGH | GPIO_PULL_DOWN)>  /* Row1 = P0.28 (D2) */
            , <&xiao_d 3 (GPIO_ACTIVE_HIGH | GPIO_PULL_DOWN)>  /* Row2 = P0.29 (D3) */
            , <&xiao_d 4 (GPIO_ACTIVE_HIGH | GPIO_PULL_DOWN)>  /* Row3 = P0.04 (D4/SDA) */
            , <&xiao_d 6 (GPIO_ACTIVE_HIGH | GPIO_PULL_DOWN)>  /* Row4 = P1.11 (D6/TX) */
            ;

        col-gpios
            = <&xiao_d 10 GPIO_ACTIVE_HIGH>  /* Col0 = P1.15 (D10/MOSI) */
            , <&xiao_d 9 GPIO_ACTIVE_HIGH>   /* Col1 = P1.14 (D9/MISO) */
            , <&xiao_d 8 GPIO_ACTIVE_HIGH>   /* Col2 = P1.13 (D8/SCK) */
            , <&xiao_d 7 GPIO_ACTIVE_HIGH>   /* Col3 = P1.12 (D7/RX) */
            , <&gpio0 10 GPIO_ACTIVE_HIGH>   /* Col4 = NFC2 (P0.10) */
            , <&gpio0 9 GPIO_ACTIVE_HIGH>    /* Col5 = NFC1 (P0.09) */
            ;
    };
};

&left_encoder {
    status = "okay";
};
